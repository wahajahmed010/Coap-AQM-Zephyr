## coap-client/drivers/sensor/scd4x/KConfig
```kconfig
# Drivers configuration options for Sensirion SCD4x

# Copyright (c) 2024 Jan Fäh
# SPDX-License-Identifier: Apache-2.0

config SCD4X
	bool "SCD4x Carbon Dioxide Sensor"
	depends on I2C
	help
	  Enable driver for the Sensirion SCD4x carbon dioxide sensors.
```

## coap-client/drivers/sensor/sps30/KConfig
```kconfig
config SPS30
    bool "Sensirion SPS30 PM Sensor Driver"
    default y
    help
      Enable the driver for the Sensirion SPS30 particulate matter sensor.
      This driver allows you to interface with the SPS30 sensor over I2C and read particulate data. 
```
